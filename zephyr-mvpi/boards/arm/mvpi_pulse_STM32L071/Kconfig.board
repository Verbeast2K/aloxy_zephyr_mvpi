## zephyr-mvpi/boards/arm/mvpi_pulse_STM32L071/Kconfig.board
```kconfig
config BOARD_MVPI_PULSE_STM32L071    
    bool "Pulse board"
    select STM32L071XX
```

## zephyr-mvpi/boards/arm/mvpi_pulse_STM32L071/Kconfig.defconfig
```kconfig
if BOARD_MVPI_PULSE_STM32L071

config BOARD
    default "MVPI_PULSE_STM32L071"

endif   # BOARD
```

## zephyr-mvpi/boards/arm/mvpi_pulse_STM32L071/board.yml
```yaml
board:
  name: mvpi_pulse_STM32L071
  vendor: aloxy
  socs:
    - name: stm32l071xx
```

## zephyr-mvpi/boards/arm/mvpi_pulse_STM32L071/mvpi_pulse_STM32L071_defconfig
```kconfig
# Zephyr Kernel Configuration
CONFIG_SOC_SERIES_STM32L0X=y

# CONFIG_SOC_${stm32l071Xz}=y
CONFIG_BOARD_MVPI_PULSE_STM32L071=y

# Enable MPU
CONFIG_ARM_MPU=n

# Enable Clocks
CONFIG_CLOCK_CONTROL=y

# Serial Drivers
CONFIG_SERIAL=y
CONFIG_UART_INTERRUPT_DRIVEN=y
# enable console
CONFIG_CONSOLE=y
CONFIG_UART_CONSOLE=y

# GPIO Controller
CONFIG_GPIO=y

# enable pin controller
CONFIG_PINCTRL=y
```

## zephyr-mvpi/drivers/rg-led/Kconfig
```kconfig
# SC620 I2C LED Controller configuration options

config SC620
    bool "SC620 - I2C LED CONTROLLER"
    default y
    depends on DT_HAS_ST_SC620_ENABLED
    select I2C
    help
        Enable I2C-based driver for SC620

rsource "Kconfig.logging"
```

## zephyr-mvpi/drivers/rg-led/Kconfig.logging
```kconfig
module = SC620
module-str = sc620
source "subsys/logging/Kconfig.template.log_config"
```

## zephyr-mvpi/dts/bindings/aloxy,modem_interface.yaml
```yaml
description: Definition of hardware used by the modem interface

compatible: "aloxy,modem_interface"

properties:
  state_pin-gpios:
    type: phandle-array
    required: true
    description: A reference to the pin that will be used by the application_mcu to indicate its state.

  target_state_pin-gpios:
    type: phandle-array
    required: true
    description: A reference to the pin that will be used by the application_mcu to sample the state of its communication partner.
```

## zephyr-mvpi/dts/bindings/rg_led/rg-led.yaml
```yaml
# ALOXY CONFIDENTIAL
# __________________
#  [2017] - [2024] Aloxy nv
# All Rights Reserved.
#  NOTICE: All information contained herein is, and remains
# the property of aloxy nv and its suppliers,
# if any. The intellectual and technical concepts contained
# herein are proprietary to Aloxy nv
# and its suppliers and may be covered by patents and
# patents in process, and are protected by trade secret or copyright law.
# Dissemination of this information or reproduction of this material
# is strictly forbidden unless prior written permission is obtained
# from Aloxy nv.

child-binding:
  description: LED child node
  properties:
    idx_red:
      type: int
      required: true
      description: |
        Index of the red LED on the controller.
    idx_green:
      type: int
      required: true
      description: |
        index of the green LED on the controller.
```

## zephyr-mvpi/dts/bindings/rg_led/st,sc620.yaml
```yaml
description: ST SC620 LED controller

compatible: "st,sc620"

include: ["i2c-device.yaml", "rg-led.yaml"]

properties:
  enable-gpios:
    type: phandle-array
    description: |
      GPIO to use to enable/disable the led controller
  brightness:
    type: int
    default: 0x00
    description: |
      Setting for Dimming register to control LED brightness on the controller
```

## zephyr-mvpi/led-driver/dts/bindings/st,sc620.yaml
```yaml
description: 

compatible: st,sc620

include: "i2c-device.yaml"

properties:
  reg:
    required: true
  
  enable-sc620:
    type: phandle
    
    required: true
    
    description: |
      GPIO to use to enable/disable the controller.
```
