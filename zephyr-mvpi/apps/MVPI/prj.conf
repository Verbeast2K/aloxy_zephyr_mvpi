## CMakeLists.txt
```
#-------------------------------------------------------------------------------
# Zephyr Example Application
#
# Copyright (c) 2021 Nordic Semiconductor ASA
# SPDX-License-Identifier: Apache-2.0

cmake_minimum_required(VERSION 3.13.1)

set(BOARD mvpi_pulse_STM32L071)
# set(FILE_SUFFIX sc620_mvpi_pulse_STM32L071)

find_package(Zephyr REQUIRED HINTS $ENV{ZEPHYR_BASE})

project(app LANGUAGES C)

target_include_directories(app PRIVATE src/inc)
target_sources(app PRIVATE src/main.c)
target_sources( 
                app PRIVATE
                src/state_machine.c
                src/sm_event_handler.c 
                src/serial_interface.c 
                src/modem.c
                src/heartbeat.c
                )
```

## Kconfig
```
# Copyright (c) 2021 Nordic Semiconductor ASA
# SPDX-License-Identifier: Apache-2.0
#
# This file is the application Kconfig entry point. All application Kconfig
# options can be defined here or included via other application Kconfig files.
# You can browse these options using the west targets menuconfig (terminal) or
# guiconfig (GUI).

menu "Zephyr"
source "Kconfig.zephyr"
endmenu

module = app
module-str = app

menu "statemachine"
    menu "Logging"
    
        config LOG
            bool "Logging"
            select PRINTK if USERSPACE
            help
                Global switch for the logger, when turned off log calls will not be
                compiled in.

        if LOG

            module = SERIAL_INTERFACE
            module-str = serial_interface
            osource "subsys/logging/Kconfig.template.log_config"

            module = MODEM
            module-str = modem
            osource "subsys/logging/Kconfig.template.log_config"

            module = HEARTBEAT
            module-str = heartbeat
            osource "subsys/logging/Kconfig.template.log_config"

            module = SM
            module-str = sm
            osource "subsys/logging/Kconfig.template.log_config"

            module = EVENT_HANDLER
            module-str = event_handler
            osource "subsys/logging/Kconfig.template.log_config"

            module = SC620
            module-str = sc620
            osource "subsys/logging/Kconfig.template.log_config"

        endif # LOG

    endmenu
endmenu
```

## prj.conf
```kconfig
# This file contains selected Kconfig options for the application.
CONFIG_LOG=y
CONFIG_LOG_DEFAULT_LEVEL=3
CONFIG_KERNEL_LOG_LEVEL_INF=y
CONFIG_CONSOLE=y
CONFIG_UART_CONSOLE=n
CONFIG_RTT_CONSOLE=y
CONFIG_USE_SEGGER_RTT=y

CONFIG_LOG_BACKEND_RTT=y
CONFIG_ASSERT=y

CONFIG_GPIO=y

# # # State machine support
CONFIG_SMF=y
CONFIG_SMF_ANCESTOR_SUPPORT=y

CONFIG_EVENTS=y

CONFIG_SYSTEM_WORKQUEUE_STACK_SIZE=2048

# # # Power Management 
# CONFIG_PM=y
CONFIG_PM_DEVICE=y
# CONFIG_PM_DEVICE_RUNTIME=y

# # # Enable the UART driver
CONFIG_UART_ASYNC_API=y

CONFIG_CRC=y

CONFIG_HEAP_MEM_POOL_SIZE=2048

# CONFIG_SC620=n

# CONFIG_FLASH=y
# CONFIG_SPI=y
# CONFIG_SPI_NOR=y
# CONFIG_FLASH_JESD216_API=y
```

## debug.conf
```kconfig
# This file contains selected Kconfig options for debugging the application.
CONFIG_LOG=y
CONFIG_LOG_DEFAULT_LEVEL=4
CONFIG_KERNEL_LOG_LEVEL_INF=y
CONFIG_CONSOLE=y
CONFIG_UART_CONSOLE=n
CONFIG_RTT_CONSOLE=y
CONFIG_USE_SEGGER_RTT=y

CONFIG_LOG_BACKEND_RTT=y
CONFIG_ASSERT=y

# CONFIG_I2C_SHELL=n
# CONFIG_I2C_DUMP_MESSAGES=y
# CONFIG_I2C_LOG_LEVEL_DBG=y

# CONFIG_DEBUG_THREAD_INFO=y
# CONFIG_DEBUG_OPTIMIZATIONS=y
```

## src/main.c
```c
/*
	Combination of an input handler function and the Zephyr SMF
	to make the MVPI state machine that switches states depending
	on the current state and the type of input
*/

#include "inc/state_machine.h"
#include "inc/modem.h"

int main(void)
{
	/* Initialize the state machine */
	state_machine_init();

	/* Initialize serial interface */
	serial_interface_initialize();

	/* Run the state machine */
	state_machine_run();
}
```

## src/heartbeat.c
```c
// #include <zephyr/kernel.h>

#include "inc/heartbeat.h"

#include <zephyr/logging/log.h>
LOG_MODULE_REGISTER(heartbeat, CONFIG_HEARTBEAT_LOG_LEVEL);

#define HEARTBEAT_VERSION 10

heartbeat_file_t heartbeat_file;

void heartbeat_counter_increment()
{
    heartbeat_file.counter += 1;
}

void heartbeat_uplinks_increment()
{
    heartbeat_file.uplinks += 1;
}

void heartbeat_uplinks_clear()
{
    heartbeat_file.uplinks = 0;
}

void heartbeat_ACK_received(bool received)
{
    if (received)
    {
        heartbeat_uplinks_clear();
        heartbeat_file.ACK = 1;
    }
    else if (!received)
    {
        heartbeat_file.ACK = 0;
    }
}

heartbeat_file_t *heartbeat_initialize()
{
    heartbeat_file.version = HEARTBEAT_VERSION;
    return &heartbeat_file;
}
```

## src/modem.c
```c
#include <zephyr/kernel.h>
#include <zephyr/drivers/uart.h>
#include <zephyr/drivers/gpio.h>
#include <zephyr/device.h>
#include <zephyr/devicetree.h>
#include <zephyr/drivers/uart.h>

#include "inc/serial_interface.h"
#include "inc/modem.h"
#include "inc/heartbeat.h"

#include <zephyr/logging/log.h>
LOG_MODULE_REGISTER(modem, CONFIG_MODEM_LOG_LEVEL);

#define UART_BUF_SIZE 0xFF

#define START_MODEM_TAG_ID 1
#define STOP_MODEM_TAG_ID 2
#define HEARTBEAT_TAG_ID 3

#define ALP_INDIRECT_FORWARD_SPEC_FILE_LORAWAN 0x44
#define ALP_INDIRECT_FORWARD 0x33
#define ALP_REQUEST_TAG 0xB4
#define ALP_RETURNFILE_DATA 0x20
#define OFFSET 0x00

#define MODEM_RESPONSE_LORAWAN_JOINING 0x63
#define MODEM_RESPONSE_LORAWAN_JOINED 0xE3
#define MODEM_RESPONSE_ACK 0xA3

#define HEARTBEAT_INTERVAL_SECONDS 60

#define UART_NODE DT_NODELABEL(lpuart1)

#define MODEM_INTERFACE_NODE DT_COMPAT_GET_ANY_STATUS_OKAY(aloxy_modem_interface)

static const struct gpio_dt_spec state_spec = GPIO_DT_SPEC_GET(MODEM_INTERFACE_NODE, state_pin_gpios);
static const struct gpio_dt_spec target_state_spec = GPIO_DT_SPEC_GET(MODEM_INTERFACE_NODE, target_state_pin_gpios);

const struct device *uart = DEVICE_DT_GET(UART_NODE);
serial_interface_t *serial_interface;
heartbeat_file_t *heartbeat;
heartbeat_payload_t heartbeat_payload;

uint8_t start_command[3] = {0xB4, 0x02, 0x35}; // 180253
uint8_t stop_command[3] = {0xB4, 0x02, 0x36};  // 180254

struct uart_data_t
{
    uint8_t data[UART_BUF_SIZE];
    uint16_t len;
};

void heartbeat_timer_cb();
K_TIMER_DEFINE(heartbeat_timer, heartbeat_timer_cb, NULL);

static void alp_handler(serial_interface_t *serial_interface, uint8_t *bytes, uint8_t length)
{
    if (length > UART_BUF_SIZE)
    {
        LOG_INF("Received data over serial that is too large %i > %i", length, UART_BUF_SIZE);
        return;
    }
    struct uart_data_t *buf = k_malloc(sizeof(*buf));
    memcpy(buf->data, bytes, length);
    buf->len = length;

    LOG_HEXDUMP_INF(buf->data, buf->len, "Received data over serial");

    switch (buf->data[0])
    {
    case MODEM_RESPONSE_ACK:
        switch (buf->data[1])
        {
        case HEARTBEAT_TAG_ID:
            heartbeat_ACK_received(true);
            LOG_INF("Heartbeat transmit success");
            break;

        case (/*START_MODEM_TAG_ID || */ STOP_MODEM_TAG_ID):
            LOG_INF("Modem start/stop success");
            break;

        default:
            break;
        }
        break;

    case MODEM_RESPONSE_LORAWAN_JOINING:
        LOG_INF("JOINING LORAWAN...");
        break;

    case MODEM_RESPONSE_LORAWAN_JOINED:
        LOG_INF("LORAWAN JOINED!");
        break;

    default:
        break;
    }
}

heartbeat_payload_t heartbeat_payload_initialize(heartbeat_file_t *heartbeat_file)
{
    heartbeat_file_t heartbeat_temp = *heartbeat_file;
    heartbeat_payload.request_tag[0] = ALP_REQUEST_TAG;
    heartbeat_payload.request_tag[1] = HEARTBEAT_TAG_ID;
    heartbeat_payload.indirect_forward[0] = ALP_INDIRECT_FORWARD;
    heartbeat_payload.indirect_forward[1] = ALP_INDIRECT_FORWARD_SPEC_FILE_LORAWAN;
    heartbeat_payload.header[0] = ALP_RETURNFILE_DATA;
    heartbeat_payload.header[1] = HEARTBEAT_TAG_ID;
    heartbeat_payload.header[2] = OFFSET;
    heartbeat_payload.header[3] = sizeof(heartbeat_temp);

    heartbeat_payload.heartbeat_file = heartbeat_temp;

    return heartbeat_payload;
}

void serial_interface_initialize()
{
    heartbeat = heartbeat_initialize();
    heartbeat_payload = heartbeat_payload_initialize(heartbeat);
    serial_interface = serial_interface_init(uart, &state_spec, &target_state_spec);
    serial_interface_register_handler(serial_interface, alp_handler, SERIAL_MESSAGE_TYPE_ALP_DATA);
}

void heartbeat_transmit()
{
    heartbeat_uplinks_increment();
    heartbeat_counter_increment();
    heartbeat_payload = heartbeat_payload_initialize(heartbeat);
    serial_interface_transfer_bytes(serial_interface, &heartbeat_payload, sizeof(heartbeat_payload), SERIAL_MESSAGE_TYPE_ALP_DATA);
    k_timer_start(&heartbeat_timer, K_SECONDS(HEARTBEAT_INTERVAL_SECONDS), K_SECONDS(HEARTBEAT_INTERVAL_SECONDS));
    heartbeat_ACK_received(false);
}

K_WORK_DEFINE(heartbeat_transmit_work, heartbeat_transmit);

void heartbeat_timer_cb()
{
    k_work_submit(&heartbeat_transmit_work);
}

void serial_interface_start()
{
    k_timer_start(&heartbeat_timer, K_SECONDS(5), K_SECONDS(HEARTBEAT_INTERVAL_SECONDS));
    serial_interface_transfer_bytes(serial_interface, &start_command, sizeof(start_command), SERIAL_MESSAGE_TYPE_ALP_DATA);
}

void serial_interface_stop()
{
    k_timer_stop(&heartbeat_timer);
    serial_interface_transfer_bytes(serial_interface, &stop_command, sizeof(stop_command), SERIAL_MESSAGE_TYPE_ALP_DATA);
}
```

## src/serial_interface.c
```c
#include "serial_interface.h"

#include <zephyr/kernel.h>
#include <zephyr/device.h>
#include <zephyr/devicetree.h>
#include <zephyr/drivers/uart.h>
#include <zephyr/logging/log.h>
#include <zephyr/sys/crc.h>

// #include "nrfx_gpiote.h"
#include <zephyr/irq.h>
#include <zephyr/pm/device.h>
#include <zephyr/pm/pm.h>

LOG_MODULE_REGISTER(serial_interface, CONFIG_SERIAL_INTERFACE_LOG_LEVEL);

#define SERIAL_INTERFACE_COUNT 1

#define UART_TX_BUF_SIZE 256
#define UART_RX_BUF_SIZE 256

#define SERIAL_FRAME_SYNC_BYTE 0xC0
#define SERIAL_FRAME_VERSION 0x00
#define SERIAL_FRAME_HEADER_SIZE 7
#define SERIAL_FRAME_SIZE 4
#define SERIAL_FRAME_COUNTER 2
#define SERIAL_FRAME_TYPE 3
#define SERIAL_FRAME_CRC1 5
#define SERIAL_FRAME_CRC2 6

#define RX_TIMEOUT 100

typedef enum
{
    STATE_IDLE,
    STATE_REQ_START,
    STATE_REQ_WAIT,
    STATE_REQ_BUSY,
    STATE_RESP,
    STATE_RESP_PENDING_REQ,
    STATE_REC
} state_t;

typedef enum
{
    BUFFER_STATE_IDLE,
    BUFFER_STATE_UART,
    BUFFER_STATE_PROCESS,
} buffer_state_t;

#define SWITCH_STATE(state, s)       \
    do                               \
    {                                \
        state = s;                   \
        LOG_DBG("switch to %s", #s); \
    } while (0)

struct serial_interface
{
    const struct gpio_dt_spec *uart_state_pin;        // MCU2MODEM Interrupt pin
    const struct gpio_dt_spec *target_uart_state_pin; // MODEM2MCU Interrupt pin
    struct gpio_callback target_state_callback;       // MODEM2MCU Interrupt callback
    state_t state;                                    // state in "execute_state_machine"
    bool request_pending;                             // Transmitting message
    bool tx_flush_busy;                               //
    const struct device *uart;                        // UART device node
    uint8_t rx_buffer[UART_RX_BUF_SIZE];              //
    uint8_t tx_buffer[UART_TX_BUF_SIZE];              //
    uint8_t tx_fifo_buffer[UART_TX_BUF_SIZE];         //
    buffer_state_t rx_buffer_state;                   //
    bool rx_active;                                   //
    bool tx_active;                                   //
    uint8_t bytes_received;                           //
    uint8_t receive_offset;                           //
    uint32_t bytes_to_transmit;                       //
    bool shutdown;                                    //
    cmd_handler_t alp_handler;                        //
    cmd_handler_t ping_handler;                       //
    cmd_handler_t logging_handler;                    //
    uint8_t packet_up_counter;                        //
    uint8_t packet_down_counter;                      //
    struct k_work process_rx_work;                    //
    struct k_work tx_work;                            //
    struct k_work state_machine_work;                 //
};

static serial_interface_t serial_interfaces[SERIAL_INTERFACE_COUNT];
static uint32_t serial_interface_count;
static void uart_event_handler(const struct device *dev, struct uart_event *evt, void *user_data);
static void execute_state_machine(struct k_work *work);

static void serial_interface_enable(serial_interface_t *serial_interface)
{
    int ret = pm_device_action_run(serial_interface->uart, PM_DEVICE_ACTION_RESUME);
    LOG_DBG("PM_RET1: %d", ret);

    serial_interface->shutdown = false;
    serial_interface->rx_active = true;
    serial_interface->rx_buffer_state = BUFFER_STATE_UART;
    ret = uart_rx_enable(serial_interface->uart, serial_interface->rx_buffer, UART_RX_BUF_SIZE, SYS_FOREVER_MS);
    __ASSERT(ret == 0, "uart_rx_enable returned with error %d", ret);
    LOG_DBG("UART enabled");
}

/** @Brief disables UART interface
 *  @return void
 */
static void serial_interface_disable(serial_interface_t *serial_interface)
{
    LOG_DBG("serial_interface_disable %d %d", serial_interface->rx_active, serial_interface->tx_active);
    if (serial_interface->rx_active || serial_interface->tx_active)
    {
        serial_interface->shutdown = true;
        if (serial_interface->rx_active)
        {
            LOG_DBG("uart_rx_disable");
            uart_rx_disable(serial_interface->uart);
        }
        if (serial_interface->tx_active)
        {
            uart_tx_abort(serial_interface->uart);
        }
    }
    else
    {
#if 0
        nrfx_uart_uninit(&serial_interface->uart);
        NRF_CLOCK->EVENTS_HFCLKSTARTED = 0;
		NRF_CLOCK->TASKS_HFCLKSTART = 0;
		/* Wait for the external oscillator to start up */
		while (NRF_CLOCK->EVENTS_HFCLKSTARTED == 0) {} 
		NRF_CLOCK->EVENTS_HFCLKSTARTED = 0;
        LOG_DBG("UART disabled");
#endif
        LOG_DBG("UART disabled");
        int ret = pm_device_action_run(serial_interface->uart, PM_DEVICE_ACTION_SUSPEND);
        LOG_DBG("PM_RET2: %d", ret);

        gpio_pin_set_dt(serial_interface->uart_state_pin, 0);
    }
}

static void listen(serial_interface_t *serial_interface)
{
    serial_interface_enable(serial_interface);
    gpio_pin_set_dt(serial_interface->uart_state_pin, 1); // set interrupt gpio to indicate ready for data
}

static void release_receiver(serial_interface_t *serial_interface)
{
    LOG_DBG("release_receiver");
    serial_interface_disable(serial_interface);
}

static bool verify_payload(serial_interface_t *serial_interface, uint8_t *bytes, uint8_t length, uint8_t *header)
{
    serial_interface->packet_down_counter++;
    if (header[SERIAL_FRAME_COUNTER] != serial_interface->packet_down_counter)
    {
        LOG_ERR("!!! missed packages: %i", (header[SERIAL_FRAME_COUNTER] - serial_interface->packet_down_counter));
        serial_interface->packet_down_counter = header[SERIAL_FRAME_COUNTER];
    }
    uint16_t calculated_crc = crc16_itu_t(0xffff, bytes, length);
    uint16_t received_crc = header[SERIAL_FRAME_CRC1] << 8 | header[SERIAL_FRAME_CRC2];
    if (calculated_crc != received_crc)
    {
        LOG_ERR("CRC not correct 0x%x != 0x%x", calculated_crc, received_crc);
        return false;
    }
    return true;
}

static void process_rx_buffer(struct k_work *work)
{
    serial_interface_t *serial_interface = CONTAINER_OF(work, serial_interface_t, process_rx_work);
    uint8_t *data = serial_interface->rx_buffer;
    uint8_t size = serial_interface->bytes_received;
    uint8_t index = 0;
    while (index < serial_interface->bytes_received)
    {
        if (size < SERIAL_FRAME_HEADER_SIZE)
        {
            LOG_ERR("Amount of received data is smaller than header size.");
            serial_interface->rx_buffer_state = BUFFER_STATE_IDLE;
            return;
        }
        if (data[index] != SERIAL_FRAME_SYNC_BYTE || data[index + 1] != SERIAL_FRAME_VERSION)
        {
            LOG_ERR("Received data is invalid 0x%x 0x%x.", data[index], data[index + 1]);
            index += 1;
            continue;
        }
        uint32_t payload_length = data[index + SERIAL_FRAME_SIZE];
        if (size < (SERIAL_FRAME_HEADER_SIZE + payload_length))
        {
            LOG_ERR("Amount of received data is smaller than packet size.");
            index += 1;
            continue;
        }
        if (!verify_payload(serial_interface, &data[index + SERIAL_FRAME_HEADER_SIZE], payload_length, data))
        {
            index += 1;
            continue;
            ;
        }
        LOG_DBG("Valid Data received!");
        if (data[index + SERIAL_FRAME_TYPE] == SERIAL_MESSAGE_TYPE_ALP_DATA && serial_interface->alp_handler)
        {
            serial_interface->alp_handler(serial_interface, &data[index + SERIAL_FRAME_HEADER_SIZE], payload_length);
        }
        else if (data[index + SERIAL_FRAME_TYPE] == SERIAL_MESSAGE_TYPE_PING_RESPONSE && serial_interface->ping_handler)
        {
            serial_interface->ping_handler(serial_interface, &data[index + SERIAL_FRAME_HEADER_SIZE], payload_length);
        }
        else if (data[index + SERIAL_FRAME_TYPE] == SERIAL_MESSAGE_TYPE_LOGGING && serial_interface->logging_handler)
        {
            serial_interface->logging_handler(serial_interface, &data[index + SERIAL_FRAME_HEADER_SIZE], payload_length);
        }
        else if (data[index + SERIAL_FRAME_TYPE] == SERIAL_MESSAGE_TYPE_PING_REQUEST)
        {
            serial_interface_transfer_bytes(serial_interface, &data[index + SERIAL_FRAME_HEADER_SIZE], payload_length,
                                            SERIAL_MESSAGE_TYPE_PING_RESPONSE);
        }
        else if (data[index + SERIAL_FRAME_TYPE] == SERIAL_MESSAGE_TYPE_REBOOTED)
        {
            LOG_INF("MODEM REBOOTED!");
        }
        index += SERIAL_FRAME_HEADER_SIZE + payload_length;
    }
    serial_interface->rx_buffer_state = BUFFER_STATE_IDLE;
}

static void flush_serial_interface_tx_buffer(struct k_work *work)
{
    serial_interface_t *serial_interface = CONTAINER_OF(work, serial_interface_t, tx_work);
    serial_interface->tx_active = false;
    int ret = uart_tx(serial_interface->uart, serial_interface->tx_buffer, serial_interface->bytes_to_transmit, SYS_FOREVER_US);
    LOG_HEXDUMP_INF(serial_interface->tx_buffer, serial_interface->bytes_to_transmit, "Sent bytes to serial interface: ");
    LOG_DBG("UART_TX_RET: %d", ret);
    // k_msleep(100);
    __ASSERT(ret == 0, "Error starting transmit %d", ret);
}

void uart_event_handler(const struct device *dev, struct uart_event *evt, void *user_data)
{
    serial_interface_t *serial_interface = (serial_interface_t *)user_data;
    int ret;
    switch (evt->type)
    {
    case UART_TX_DONE:
        LOG_DBG("TX_DONE");
        __ASSERT(serial_interface->bytes_to_transmit == evt->data.tx.len, "Not all bytes transmitted. %d bytes lost",
                 serial_interface->bytes_to_transmit - evt->data.tx.len);
        serial_interface->request_pending = false;
        serial_interface->tx_flush_busy = false;
        serial_interface->tx_active = false;
        serial_interface->bytes_to_transmit = 0;
        release_receiver(serial_interface);
        ret = k_work_submit(&serial_interface->state_machine_work);
        __ASSERT(ret >= 0, "Failed to submit state_machine_work %d", ret);
        break;
    case UART_TX_ABORTED:
        LOG_DBG("UART_TX_ABORTED");
        serial_interface->request_pending = false;
        serial_interface->tx_flush_busy = false;
        serial_interface->tx_active = false;
        serial_interface->bytes_to_transmit = 0;
        LOG_DBG("UART_TX_ABORTED");
        break;
    case UART_RX_RDY:
        LOG_DBG("RX_DONE");
        serial_interface->bytes_received = evt->data.rx.len;
        __ASSERT(evt->data.rx.offset == 0, "Expected an offset of 0, %d instead", evt->data.rx.offset);
        serial_interface->rx_active = false;
        if (serial_interface->bytes_received > 0)
        {
            serial_interface->rx_buffer_state = BUFFER_STATE_PROCESS;
            ret = k_work_submit(&serial_interface->process_rx_work);
            __ASSERT(ret >= 0, "Submitting process_rx_work failed with error %d", ret);
        }
        break;
    case UART_RX_BUF_REQUEST:
        /* We only work with one buffer */
        break;
    case UART_RX_BUF_RELEASED:
        LOG_DBG("UART_RX_BUF_RELEASED");
        break;
    case UART_RX_DISABLED:
        LOG_DBG("UART_RX_DISABLED");
        serial_interface->rx_active = false;
        if (serial_interface->rx_buffer_state == BUFFER_STATE_UART)
        {
            serial_interface->rx_buffer_state = BUFFER_STATE_IDLE;
        }
        release_receiver(serial_interface);
        break;
    case UART_RX_STOPPED:
        LOG_ERR("Rx stopped due to 0x%x. %d bytes were received => dropping", evt->data.rx_stop.reason, evt->data.rx_stop.data.len);
        serial_interface->rx_active = false;
        serial_interface->rx_buffer_state = BUFFER_STATE_IDLE;
        break;
    }
    if (serial_interface->shutdown && !serial_interface->rx_active && !serial_interface->tx_active)
    {
        serial_interface->shutdown = false;
        ret = pm_device_action_run(serial_interface->uart, PM_DEVICE_ACTION_SUSPEND);
        LOG_DBG("PM_RET3: %d", ret);

        LOG_DBG("UART disabled (event)");
    }
}

static void execute_state_machine(struct k_work *work)
{
    serial_interface_t *serial_interface = CONTAINER_OF(work, serial_interface_t, state_machine_work);
    int ret;
    LOG_DBG("STATE: %d\n", serial_interface->state);
    switch (serial_interface->state)
    {
    case STATE_REC:
        if (gpio_pin_get_dt(serial_interface->target_uart_state_pin))
            break;
        SWITCH_STATE(serial_interface->state, STATE_RESP);
        // Intentional fall through
    case STATE_RESP:
    {
        // response period completed, abort reception witch will trigger uart event handler
        uart_rx_disable(serial_interface->uart);
        if (serial_interface->request_pending)
        {
            SWITCH_STATE(serial_interface->state, STATE_RESP_PENDING_REQ);
            ret = k_work_submit(&serial_interface->state_machine_work);
            __ASSERT(ret >= 0, "Failed to submit state_machine_work %d", ret);
        }
        else
        {
            SWITCH_STATE(serial_interface->state, STATE_IDLE);
            gpio_pin_set_dt(serial_interface->uart_state_pin, 0);
            serial_interface_disable(serial_interface);
        }
        break;
    }
    case STATE_IDLE:
        if (gpio_pin_get_dt(serial_interface->target_uart_state_pin))
        {
            // Check if receive buffer is available otherwise just wait
            if (serial_interface->rx_buffer_state == BUFFER_STATE_IDLE)
            {
                // wake-up requested
                SWITCH_STATE(serial_interface->state, STATE_REC);
                listen(serial_interface);
            }
            else
            {
                ret = k_work_submit(&serial_interface->state_machine_work);
                __ASSERT(ret >= 0, "Failed to submit state_machine_work %d", ret);
            }
            break;
        }
        else if (serial_interface->request_pending)
        { // check if we are really requesting a start
            SWITCH_STATE(serial_interface->state, STATE_REQ_START);
            // fall-through to STATE_REQ_START!
        }
        else
        {
            break;
        }
    case STATE_REQ_START:
        // TODO timeout
        SWITCH_STATE(serial_interface->state, STATE_REQ_WAIT);
        gpio_pin_set_dt(serial_interface->uart_state_pin, 1); // wake-up receiver
        LOG_DBG("wake-up receiver");
        ret = k_work_submit(&serial_interface->state_machine_work);
        __ASSERT(ret >= 0, "Failed to submit state_machine_work %d", ret); // reschedule again to prevent sleeoping
        // in principle we could go to sleep but this will cause pin to float, this can be improved later
        break;
    case STATE_REQ_WAIT:
        if (gpio_pin_get_dt(serial_interface->target_uart_state_pin))
        {
            // receiver active
            SWITCH_STATE(serial_interface->state, STATE_REQ_BUSY);
            // fall-through to STATE_REQ_BUSY!
        }
        else
        {
            // TODO timeout
            ret = k_work_submit(&serial_interface->state_machine_work);
            __ASSERT(ret >= 0, "Failed to submit state_machine_work %d", ret); // reschedule again to prevent sleeoping
            // in principle we could go to sleep but this will cause pin to float, this can be improved later
            break;
        }
    case STATE_REQ_BUSY:
        if (serial_interface->request_pending)
        {
            // if receiver reacts fast this code is executed twice (once due to the fall through of the previous state and once scheduled by the
            // uart_int_cb) To be sure that serial_interface_enable is not called the second time when the transfer is already busy it is
            // guaranteed that the code is only executed once.
            if (!serial_interface->tx_flush_busy)
            {
                serial_interface->tx_flush_busy = true;
                serial_interface_enable(serial_interface);
                ret = k_work_submit(&serial_interface->tx_work);
                __ASSERT(ret >= 0, "Failed to queue Tx work %d", ret);
                LOG_DBG("TX_WORK_RET: %d", ret);

                //
            }
        }
        else if (!gpio_pin_get_dt(serial_interface->target_uart_state_pin))
        {
            SWITCH_STATE(serial_interface->state, STATE_IDLE);
            ret = k_work_submit(&serial_interface->state_machine_work);
            __ASSERT(ret >= 0, "Failed to submit state_machine_work %d", ret);
        }
        else
        {
            ret = k_work_submit(&serial_interface->state_machine_work);
            __ASSERT(ret >= 0, "Failed to submit state_machine_work %d", ret);
            // keep active until target reacts
        }
        break;
    case STATE_RESP_PENDING_REQ:
        __ASSERT_NO_MSG(serial_interface->request_pending);
        // response period completed, initiate pending request by switching to REQ_START
        __ASSERT_NO_MSG(!gpio_pin_get_dt(serial_interface->target_uart_state_pin));
        gpio_pin_set_dt(serial_interface->uart_state_pin, 0);
        SWITCH_STATE(serial_interface->state, STATE_REQ_START);
        ret = k_work_submit(&serial_interface->state_machine_work);
        __ASSERT(ret >= 0, "Failed to submit state_machine_work %d", ret);
        break;
    default:
        LOG_ERR("unexpected state %i\n", serial_interface->state);
        __ASSERT_NO_MSG(false);
    }
}

static void target_state_cb(const struct device *port, struct gpio_callback *cb, gpio_port_pins_t pins)
{
    // do not read GPIO level here in interrupt context (GPIO clock might not be enabled yet), execute state machine instead
    LOG_DBG("Modem pin interrupt callback");
    int ret;
    // k_msleep(100);
    serial_interface_t *serial_interface = CONTAINER_OF(cb, serial_interface_t, target_state_callback);
    LOG_DBG("INT %d", gpio_pin_get_dt(serial_interface->target_uart_state_pin));
    ret = k_work_submit(&serial_interface->state_machine_work);
    __ASSERT(ret >= 0, "Failed to submit state_machine_work %d", ret);
}

serial_interface_t *serial_interface_init(const struct device *uart, const struct gpio_dt_spec *uart_state_pin,
                                          const struct gpio_dt_spec *target_uart_state_pin)
{
    int ret;
    __ASSERT_NO_MSG(serial_interface_count < SERIAL_INTERFACE_COUNT);
    serial_interface_t *serial_interface = &serial_interfaces[serial_interface_count];
    serial_interface_count++;
    uart_callback_set(uart, uart_event_handler, serial_interface);
    serial_interface->uart = uart;
    // Uart by default enabled by OS => disable
    ret = pm_device_action_run(serial_interface->uart, PM_DEVICE_ACTION_SUSPEND);
    LOG_DBG("PM_RET4: %d", ret);

    serial_interface->uart_state_pin = uart_state_pin;
    serial_interface->target_uart_state_pin = target_uart_state_pin;
    serial_interface->rx_buffer_state = BUFFER_STATE_IDLE;

    k_work_init(&serial_interface->process_rx_work, process_rx_buffer);
    k_work_init(&serial_interface->tx_work, flush_serial_interface_tx_buffer);
    k_work_init(&serial_interface->state_machine_work, execute_state_machine);

    gpio_pin_configure_dt(uart_state_pin, GPIO_OUTPUT_INACTIVE);
    gpio_pin_configure_dt(target_uart_state_pin, GPIO_INPUT);
    gpio_init_callback(&serial_interface->target_state_callback, target_state_cb, BIT(target_uart_state_pin->pin));
    gpio_add_callback(target_uart_state_pin->port, &serial_interface->target_state_callback);
    gpio_pin_interrupt_configure_dt(target_uart_state_pin, GPIO_INT_EDGE_BOTH);
    if (gpio_pin_get_dt(target_uart_state_pin))
    {
        ret = k_work_submit(&serial_interface->state_machine_work);
        __ASSERT(ret >= 0, "Failed to submit state_machine_work %d", ret);
    }
    return serial_interface;
}

void serial_interface_transfer_bytes(serial_interface_t *serial_interface, const uint8_t *bytes, uint8_t length, serial_message_type_t type)
{
    int ret;
    LOG_DBG("serial_interface_transfer_bytes");
    if (serial_interface->tx_flush_busy)
    {
        __ASSERT(0, "Transmit in progress, data will be dropped.");
        return;
    }
    if ((SERIAL_FRAME_HEADER_SIZE + length) > (UART_TX_BUF_SIZE - serial_interface->bytes_to_transmit))
    {
        __ASSERT(0, "Data will not fit in buffer, data will be dropped %d > %d.", (SERIAL_FRAME_HEADER_SIZE + length),
                 (UART_TX_BUF_SIZE - serial_interface->bytes_to_transmit));
        return;
    }
    uint8_t header[SERIAL_FRAME_HEADER_SIZE];
    uint16_t crc = crc16_itu_t(0xffff, bytes, length);

    serial_interface->packet_up_counter++;
    header[0] = SERIAL_FRAME_SYNC_BYTE;
    header[1] = SERIAL_FRAME_VERSION;

    header[SERIAL_FRAME_COUNTER] = serial_interface->packet_up_counter;
    header[SERIAL_FRAME_TYPE] = type;
    header[SERIAL_FRAME_SIZE] = length;
    header[SERIAL_FRAME_CRC1] = (crc >> 8) & 0x00FF;
    header[SERIAL_FRAME_CRC2] = crc & 0x00FF;

    unsigned int lock_key = irq_lock();
    memcpy(&serial_interface->tx_buffer[serial_interface->bytes_to_transmit], header, SERIAL_FRAME_HEADER_SIZE);
    serial_interface->bytes_to_transmit += SERIAL_FRAME_HEADER_SIZE;
    memcpy(&serial_interface->tx_buffer[serial_interface->bytes_to_transmit], bytes, length);
    serial_interface->bytes_to_transmit += length;
    serial_interface->request_pending = true;
    irq_unlock(lock_key);
    ret = k_work_submit(&serial_interface->state_machine_work);
    __ASSERT(ret >= 0, "Failed to submit state_machine_work %d", ret);
}

void serial_interface_register_handler(serial_interface_t *serial_interface, cmd_handler_t cmd_handler, serial_message_type_t type)
{
    switch (type)
    {
    case SERIAL_MESSAGE_TYPE_ALP_DATA:
        serial_interface->alp_handler = cmd_handler;
        break;
    case SERIAL_MESSAGE_TYPE_PING_RESPONSE:
        serial_interface->ping_handler = cmd_handler;
        break;
    case SERIAL_MESSAGE_TYPE_LOGGING:
        serial_interface->logging_handler = cmd_handler;
        break;
    default:
        LOG_ERR("Message handler not supported for given type.");
        break;
    }
}

void serial_interface_unregister_handler(serial_interface_t *serial_interface, serial_message_type_t type)
{
    serial_interface_register_handler(serial_interface, NULL, type);
}
```

## src/state_machine.c
```c
#include "inc/state_machine.h"
#include "inc/sm_event_handler.h"
#include "inc/modem.h"

#include <zephyr/kernel.h>
#include <zephyr/smf.h>
#include <zephyr/drivers/gpio.h>
#include <stdbool.h>
#include "rg_led/rg_led.h"

#include <zephyr/logging/log.h>
LOG_MODULE_REGISTER(sm, CONFIG_SM_LOG_LEVEL);

int ret;

const struct device *const led_dev = DEVICE_DT_GET(DT_NODELABEL(ledcontroller));

/* Forward declaration of state table */
struct smf_state mvpi_states[];

// /* User defined object */
struct s_object
{
	/* This must be first */
	struct smf_ctx ctx;

	/* Events */
	struct k_event smf_event;
	int32_t events;

	/* Other state specific data add here */
} s_obj;

/* List of MVPI states */
enum mvpi_state
{
	Standby,
	Operational,
	Configuration,
	Configuration_idle,
	Reset_menu,
	Standby_state,
	Factory_reset
};

uint8_t state_index = Standby;

/* List of rg_led colors including "off" */
enum led_color
{
	LED_COLOR_RED = RG_LED_COLOR_RED,
	LED_COLOR_GREEN = RG_LED_COLOR_GREEN,
	LED_COLOR_YELLOW = RG_LED_COLOR_YELLOW,
	LED_COLOR_OFF = 3,
};

enum led
{
	LED_LEFT = 0,
	LED_RIGHT = 1,
};

struct state_leds
{
	enum led_color led_color_left;
	enum led_color led_color_right;
};

/**
 *  @def leds_off()
 * @brief Function to turn off both LEDs
 */
void leds_off();

/**
 *  @def leds_off_caller()
 * @brief Function to start timer for calling leds_off
 */
void leds_off_caller();

/**
 *  @def show_state()
 * @param stay_on   Flag that will keep the LED state display on if enabled
 * @brief Function to show state using LEDs
 */
void show_state(bool stay_on);

/**
 *  @def timeout_handler()
 * @brief Function to revert to Operational state from Configuration
 */
void timeout_handler();

/**
 *  @def timeout_handler_caller()
 * @brief Function to start timer for calling timeout_handler
 */
void timeout_handler_caller();

/**
 *  @def standby_entry()
 * @brief Function to run once, on entering Standby state
 */
void Standby_entry(void *o);

/**
 *  @def standby_run()
 * @brief Main function to run in Standby state
 */
void Standby_run(void *o);

/**
 *  @def standby_exit()
 * @brief Function to run once, on exiting Standby state
 */
void Standby_exit(void *o);

/**
 *  @def operational_entry()
 * @brief Function to run once, on entering Operational state
 */
void Operational_entry(void *o);

/**
 *  @def operational_run()
 * @brief Main function to run in Operational state
 */
void Operational_run(void *o);

/**
 *  @def operational_exit()
 * @brief Function to run once, on exiting Operational state
 */
void Operational_exit(void *o);

/**
 *  @def configuration_entry()
 * @brief Function to run once, on entering Configuration state
 */
void Configuration_entry(void *o);

/**
 *  @def configuration_exit()
 * @brief Function to run once, on exiting Configuration state
 */
void Configuration_exit(void *o);

/**
 *  @def configuration_idle_entry()
 * @brief Function to run once, on entering Configuration_idle state
 */
void Configuration_idle_entry(void *o);

/**
 *  @def configuration_idle_run()
 * @brief Main function to run in Configuration_idle state
 */
void Configuration_idle_run(void *o);

/**
 *  @def Reset_menu_entry()
 * @brief Function to run once, on entering Reset_menu state
 */
void Reset_menu_entry(void *o);

/**
 *  @def Reset_menu_run()
 * @brief Main function to run in Reset_menu state
 */
void Reset_menu_run(void *o);

void Reset_menu_exit(void *o);

/**
 *  @def Standby_state_entry()
 * @brief Function to run once, on entering Standby_state state
 */
void Standby_state_entry(void *o);

/**
 *  @def Standby_state_run()
 * @brief Main function to run in Standby_state state
 */
void Standby_state_run(void *o);

void Standby_state_exit(void *o);

/**
 *  @def Factory_reset_entry()
 * @brief Function to run once, on entering Factory_reset state
 */
void Factory_reset_entry(void *o);

/**
 *  @def Factory_reset_run()
 * @brief Main function to run in Factory_reset state
 */
void Factory_reset_run(void *o);

void Factory_reset_exit(void *o);

const struct state_leds state_to_state_leds[] = {
	[Standby] = {LED_COLOR_RED, LED_COLOR_RED},
	[Operational] = {LED_COLOR_GREEN, LED_COLOR_GREEN},
	[Configuration] = {LED_COLOR_YELLOW, LED_COLOR_YELLOW},
	[Configuration_idle] = {LED_COLOR_OFF, LED_COLOR_OFF},
	[Reset_menu] = {LED_COLOR_RED, LED_COLOR_OFF},
	[Standby_state] = {LED_COLOR_RED, LED_COLOR_GREEN},
	[Factory_reset] = {LED_COLOR_RED, LED_COLOR_RED}};

// Define function to turn off both leds
void leds_off()
{
	LOG_DBG("leds off\n");
	rg_led_off(led_dev, LED_LEFT);
	rg_led_off(led_dev, LED_RIGHT);
}
K_WORK_DEFINE(leds_off_work, leds_off);

// Define function to submit leds_off to workqueue using the timer
void leds_off_caller()
{
	k_work_submit(&leds_off_work);
}
K_TIMER_DEFINE(led_timer, leds_off_caller, NULL);

void show_state(bool stay_on)
{
	struct state_leds led_colors = state_to_state_leds[state_index];

	if (led_colors.led_color_left == LED_COLOR_OFF)
	{
		rg_led_off(led_dev, LED_LEFT);
	}
	else
	{
		rg_led_on(led_dev, LED_LEFT, led_colors.led_color_left);
	}

	if (led_colors.led_color_right == LED_COLOR_OFF)
	{
		rg_led_off(led_dev, LED_RIGHT);
	}
	else
	{
		rg_led_on(led_dev, LED_RIGHT, led_colors.led_color_right);
	}

	if (!stay_on)
	{
		k_timer_start(&led_timer, K_SECONDS(1), K_NO_WAIT);
	}
}

/* 30S timer for configuration timeout */
void timeout_handler()
{
	if (state_index > Operational)
	{
		smf_set_state(SMF_CTX(&s_obj), &mvpi_states[Operational]);
	}
}
K_WORK_DEFINE(timeout_handler_work, timeout_handler);

void timeout_handler_caller()
{
	k_work_submit(&timeout_handler_work);
}
K_TIMER_DEFINE(timeout, timeout_handler_caller, NULL);

/* 1S timer for exiting Configuration_idle mode */
void enter_configuration_idle()
{
	leds_off();
}
K_WORK_DEFINE(enter_configuration_idle_work, enter_configuration_idle);

void enter_configuration_idle_caller()
{
	k_work_submit(&enter_configuration_idle_work);
}
K_TIMER_DEFINE(configuration_led_timeout, enter_configuration_idle_caller, NULL);

/* State Standby */
void Standby_entry(void *o)
{
	LOG_INF("Standby\n");
	state_index = Standby;
	show_state(false);
}

void Standby_run(void *o)
{
	ret = k_event_wait(&s_obj.smf_event, 0x1F, false, K_NO_WAIT);
	k_event_clear(&s_obj.smf_event, 0x1F);

	switch (ret)
	{
	case EVENT_HOLD_BOTH_3S:
		smf_set_state(SMF_CTX(&s_obj), &mvpi_states[Operational]);
		break;

	case EVENT_HOLD_RIGHT:
		show_state(true);
		break;

	case EVENT_PRESS_RIGHT:
		leds_off();
		break;

	default:
		break;
	}
}

void Standby_exit(void *o)
{
	leds_off();
}

/* State Operational */
void Operational_entry(void *o)
{
	LOG_INF("Operational\n");
	state_index = Operational;
	show_state(false);
	serial_interface_start();
}

void Operational_run(void *o)
{
	ret = k_event_wait(&s_obj.smf_event, 0x1F, false, K_NO_WAIT);
	k_event_clear(&s_obj.smf_event, 0x1F);

	switch (ret)
	{
	case EVENT_HOLD_BOTH_3S:
		smf_set_state(SMF_CTX(&s_obj), &mvpi_states[Configuration_idle]);
		break;

	case EVENT_HOLD_RIGHT:
		show_state(true);
		break;

	case EVENT_PRESS_RIGHT:
		leds_off();
		break;

		// case EVENT_PRESS_LEFT:
		// 	serial_interface_transfer_bytes(serial_interface, &uart_msg, sizeof(uart_msg), SERIAL_MESSAGE_TYPE_ALP_DATA);
		// 	uart_msg += 1;

	default:
		break;
	}
}

void Operational_exit(void *o)
{
	leds_off();
	serial_interface_stop();
}

void Configuration_entry(void *o)
{
	state_index = Configuration;
	show_state(false);
	k_timer_start(&configuration_led_timeout, K_SECONDS(1), K_NO_WAIT);
}

void Configuration_exit(void *o)
{
	leds_off();
}

void Configuration_idle_entry(void *o)
{
	state_index = Configuration_idle;
	LOG_INF("Configuration_idle\n");
}

void Configuration_idle_run(void *o)
{
	ret = k_event_wait(&s_obj.smf_event, 0x1F, false, K_NO_WAIT);
	k_event_clear(&s_obj.smf_event, 0x1F);

	switch (ret)
	{
	case EVENT_HOLD_BOTH_3S:
		smf_set_state(SMF_CTX(&s_obj), &mvpi_states[Operational]);
		break;

	case EVENT_PRESS_LEFT:
		smf_set_state(SMF_CTX(&s_obj), &mvpi_states[Reset_menu]);
		break;
	}
}

/* State Reset_menu */
void Reset_menu_entry(void *o)
{
	state_index = Reset_menu;
	LOG_INF("Reset_menu\n");
	show_state(true);

	k_timer_start(&timeout, K_SECONDS(30), K_NO_WAIT);
}

void Reset_menu_run(void *o)
{
	ret = k_event_wait(&s_obj.smf_event, 0x1F, false, K_NO_WAIT);
	k_event_clear(&s_obj.smf_event, 0x1F);

	switch (ret)
	{
	case EVENT_HOLD_BOTH_3S:
		smf_set_state(SMF_CTX(&s_obj), &mvpi_states[Operational]);
		break;

	case EVENT_PRESS_LEFT:
		smf_set_state(SMF_CTX(&s_obj), &mvpi_states[Configuration_idle]);
		break;

	case EVENT_PRESS_RIGHT:
		smf_set_state(SMF_CTX(&s_obj), &mvpi_states[Standby_state]);
		break;

	default:
		break;
	}
}

void Reset_menu_exit(void *o)
{
	leds_off();
}

/* State Standby_state */
void Standby_state_entry(void *o)
{
	k_timer_start(&timeout, K_SECONDS(30), K_NO_WAIT);

	LOG_INF("Standby_state\n");
	state_index = Standby_state;
	show_state(true);
}

void Standby_state_run(void *o)
{
	ret = k_event_wait(&s_obj.smf_event, 0x1F, false, K_NO_WAIT);
	k_event_clear(&s_obj.smf_event, 0x1F);

	switch (ret)
	{
	case EVENT_HOLD_BOTH_3S:
		smf_set_state(SMF_CTX(&s_obj), &mvpi_states[Operational]);
		break;

	case EVENT_PRESS_RIGHT:
		smf_set_state(SMF_CTX(&s_obj), &mvpi_states[Factory_reset]);
		break;

	case EVENT_PRESS_BOTH:
		smf_set_state(SMF_CTX(&s_obj), &mvpi_states[Standby]);
		break;

	default:
		break;
	}
}

void Standby_state_exit(void *o)
{
	leds_off();
}

/* State Factory_reset */
void Factory_reset_entry(void *o)
{
	k_timer_start(&timeout, K_SECONDS(30), K_NO_WAIT);

	LOG_INF("Factory_reset\n");
	state_index = Factory_reset;
	show_state(true);
}

void Factory_reset_run(void *o)
{
	ret = k_event_wait(&s_obj.smf_event, 0x1F, false, K_NO_WAIT);
	k_event_clear(&s_obj.smf_event, 0x1F);

	switch (ret)
	{
	case EVENT_HOLD_BOTH_3S:
		smf_set_state(SMF_CTX(&s_obj), &mvpi_states[Operational]);
		break;

	case EVENT_PRESS_RIGHT:
		smf_set_state(SMF_CTX(&s_obj), &mvpi_states[Reset_menu]);
		break;

	case EVENT_PRESS_BOTH:
		printk("Factory Resetting...\n");
		break;

	default:
		break;
	}
}

void Factory_reset_exit(void *o)
{
	leds_off();
}

/* Populate state table */
struct smf_state mvpi_states[] = {
	[Standby] = SMF_CREATE_STATE(Standby_entry, Standby_run, Standby_exit, NULL),
	[Operational] = SMF_CREATE_STATE(Operational_entry, Operational_run, Operational_exit, NULL),
	[Configuration] = SMF_CREATE_STATE(Configuration_entry, NULL, Configuration_exit, NULL),
	[Configuration_idle] = SMF_CREATE_STATE(Configuration_idle_entry, Configuration_idle_run, NULL, &mvpi_states[Configuration]),
	[Reset_menu] = SMF_CREATE_STATE(Reset_menu_entry, Reset_menu_run, Reset_menu_exit, &mvpi_states[Configuration]),
	[Standby_state] = SMF_CREATE_STATE(Standby_state_entry, Standby_state_run, Standby_state_exit, &mvpi_states[Configuration]),
	[Factory_reset] = SMF_CREATE_STATE(Factory_reset_entry, Factory_reset_run, Factory_reset_exit, &mvpi_states[Configuration]),
};

void state_machine_init()
{

	sm_event_handler_init(&s_obj.smf_event);

	/* Setup led controller */
	if (!led_dev)
	{
		LOG_ERR("No device found\n");
	}
	else if (!device_is_ready(led_dev))
	{
		LOG_ERR("led device is not ready\n");
	}
	else
	{
		LOG_INF("found led device %s\n", led_dev->name);
	}

	/* Set initial state */
	smf_set_initial(SMF_CTX(&s_obj), &mvpi_states[Standby]);
}

void state_machine_run()
{
	/* Run the state machine */
	while (1)
	{
		k_msleep(100);
		ret = smf_run_state(SMF_CTX(&s_obj));
	}
}
```
