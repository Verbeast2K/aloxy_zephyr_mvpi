## CMakeLists.txt
```
#-------------------------------------------------------------------------------
# Zephyr Example Application
#
# Copyright (c) 2021 Nordic Semiconductor ASA
# SPDX-License-Identifier: Apache-2.0

cmake_minimum_required(VERSION 3.13.1)

set(BOARD mvpi_pulse_STM32L071)
# set(FILE_SUFFIX sc620_mvpi_pulse_STM32L071)

find_package(Zephyr REQUIRED HINTS $ENV{ZEPHYR_BASE})

project(app LANGUAGES C)

target_include_directories(app PRIVATE src/inc)
target_sources(app PRIVATE src/main.c)
target_sources(app PRIVATE src/state_machine.c src/sm_event_handler.c)
```

## Kconfig
```
# Copyright (c) 2021 Nordic Semiconductor ASA
# SPDX-License-Identifier: Apache-2.0
#
# This file is the application Kconfig entry point. All application Kconfig
# options can be defined here or included via other application Kconfig files.
# You can browse these options using the west targets menuconfig (terminal) or
# guiconfig (GUI).

menu "Zephyr"
source "Kconfig.zephyr"
endmenu

module = app
module-str = app

menu "statemachine"
    menu "Logging"
    
        config LOG
            bool "Logging"
            select PRINTK if USERSPACE
            help
                Global switch for the logger, when turned off log calls will not be
                compiled in.

        if LOG

            module = SM
            module-str = sm
            osource "subsys/logging/Kconfig.template.log_config"

            module = EVENT_HANDLER
            module-str = event_handler
            osource "subsys/logging/Kconfig.template.log_config"

            module = SC620
            module-str = sc620
            osource "subsys/logging/Kconfig.template.log_config"

        endif # LOG

    endmenu
endmenu
```

## prj.conf
```kconfig
# Copyright (c) 2021 Nordic Semiconductor ASA
# SPDX-License-Identifier: Apache-2.0
#
# This file contains selected Kconfig options for the application.

CONFIG_LOG=n
CONFIG_LOG_DEFAULT_LEVEL=3
# CONFIG_CONSOLE=n
# CONFIG_UART_CONSOLE=n
# CONFIG_RTT_CONSOLE=y
# CONFIG_USE_SEGGER_RTT=y

CONFIG_GPIO=y
# CONFIG_I2C_SHELL=n
# CONFIG_I2C_DUMP_MESSAGES=y
# CONFIG_I2C_LOG_LEVEL_DBG=y

# # State machine support
CONFIG_SMF=y
CONFIG_SMF_ANCESTOR_SUPPORT=y

CONFIG_EVENTS=y

# CONFIG_SYSTEM_WORKQUEUE_STACK_SIZE=1024
```

## debug.conf
```kconfig
# Copyright (c) 2021 Nordic Semiconductor ASA
# SPDX-License-Identifier: Apache-2.0
#
# This is a Kconfig fragment which can be used to enable debug-related options
# in the application. See the README for more details.

# compiler
CONFIG_DEBUG_OPTIMIZATIONS=y

# console
# CONFIG_CONSOLE=y

# CONFIG_LOG=y
# CONFIG_UART_CONSOLE=n
# CONFIG_RTT_CONSOLE=y
# CONFIG_USE_SEGGER_RTT=y

# # I2C logging
# CONFIG_I2C=y
# CONFIG_I2C_DUMP_MESSAGES=y
# CONFIG_I2C_LOG_LEVEL_DBG=y
```

## src/main.c
```c
/*
	Combination of an input handler function and the Zephyr SMF
	to make the MVPI state machine that switches states depending
	on the current state and the type of input
*/

#include "inc/state_machine.h"

int main(void)
{
	/* Initialise the state machine */
	state_machine_init();

	/* Run the state machine */
	state_machine_run();
}
```

## src/sm_event_handler.c
```c
#include "inc/sm_event_handler.h"
#include "inc/state_machine.h"

#include <zephyr/logging/log.h>
LOG_MODULE_REGISTER(event_handler, CONFIG_EVENT_HANDLER_LOG_LEVEL);

#define button1 DT_NODELABEL(button1)
#define button2 DT_NODELABEL(button2)

static const struct gpio_dt_spec button1 = GPIO_DT_SPEC_GET(button1, gpios);
static const struct gpio_dt_spec button2 = GPIO_DT_SPEC_GET(button2, gpios);
static struct gpio_callback button_cb;

/* holds the outer events which should be posted*/
static struct k_event *sm_events;

/* events for internal use */
#define EVENT_BTN_LEFT_DOWN BIT(0)
#define EVENT_BTN_LEFT_UP BIT(1)
#define EVENT_BTN_RIGHT_DOWN BIT(2)
#define EVENT_BTN_RIGHT_UP BIT(3)
#define EVENT_TIMER_3S BIT(4)
#define EVENT_TIMER_10S BIT(5)

enum sm_event_handler_state
{
    IDLE,
    LEFT_PRESSED,
    RIGHT_PRESSED,
    BOTH_PRESSED,
};

static void run_sm(struct k_work *work);
K_WORK_DEFINE(sm_event_handler_run, &run_sm);

static void idle_entry(void *o);
static void idle_run(void *o);
static void left_pressed_entry(void *o);
static void left_pressed_run(void *o);
static void right_pressed_entry(void *o);
static void right_pressed_run(void *o);
static void both_pressed_entry(void *o);
static void both_pressed_run(void *o);

struct smf_state sm_event_handler_states[] = {
    [IDLE] = SMF_CREATE_STATE(idle_entry, idle_run, NULL, NULL),
    [LEFT_PRESSED] = SMF_CREATE_STATE(left_pressed_entry, left_pressed_run, NULL, NULL),
    [RIGHT_PRESSED] = SMF_CREATE_STATE(right_pressed_entry, right_pressed_run, NULL, NULL),
    [BOTH_PRESSED] = SMF_CREATE_STATE(both_pressed_entry, both_pressed_run, NULL, NULL),
};

// /* User defined object */
struct smf_event_handler_obj
{
    /* This must be first */
    struct smf_ctx ctx;

    /* Events */
    struct k_event input_events;
    int32_t events;

    /* Other state specific data add here */
    uint8_t hold_time;
} smf_event_handler;

static void hold_timer_cb(struct k_timer *timer);
K_TIMER_DEFINE(hold_timer, hold_timer_cb, NULL);

static void button_cb_f(const struct device *dev, struct gpio_callback *cb, uint32_t pins)
{
    if (pins & BIT(button1.pin))
    {
        if (gpio_pin_get_dt(&button1))
        {
            k_event_post(&smf_event_handler.input_events, EVENT_BTN_RIGHT_DOWN);
        }
        else
        {
            k_event_post(&smf_event_handler.input_events, EVENT_BTN_RIGHT_UP);
        }
    }
    if (pins & BIT(button2.pin))
    {
        if (gpio_pin_get_dt(&button2))
        {
            k_event_post(&smf_event_handler.input_events, EVENT_BTN_LEFT_DOWN);
        }
        else
        {
            k_event_post(&smf_event_handler.input_events, EVENT_BTN_LEFT_UP);
        }
    }
    k_work_submit(&sm_event_handler_run);
}

static int buttons_init()
{
    int ret;

    // BUTTON 1 SETUP
    if (!gpio_is_ready_dt(&button1))
    {
        LOG_ERR("Error: button device %s is not ready\n",
                button1.port->name);
        return 0;
    }

    ret = gpio_pin_configure_dt(&button1, GPIO_INPUT);
    if (ret != 0)
    {
        LOG_ERR("Error %d: failed to configure %s pin %d\n",
                ret, button1.port->name, button1.pin);
        return 0;
    }

    ret = gpio_pin_interrupt_configure_dt(&button1,
                                          GPIO_INT_EDGE_BOTH);
    if (ret != 0)
    {
        LOG_ERR("Error %d: failed to configure interrupt on %s pin %d\n",
                ret, button1.port->name, button1.pin);
        return 0;
    }

    // BUTTON 2 SETUP
    if (!gpio_is_ready_dt(&button1))
    {
        LOG_ERR("Error: button device %s is not ready\n",
                button1.port->name);
        return 0;
    }

    ret = gpio_pin_configure_dt(&button2, GPIO_INPUT);
    if (ret != 0)
    {
        LOG_ERR("Error %d: failed to configure %s pin %d\n",
                ret, button2.port->name, button2.pin);
        return 0;
    }

    ret = gpio_pin_interrupt_configure_dt(&button2,
                                          GPIO_INT_EDGE_BOTH);
    if (ret != 0)
    {
        LOG_ERR("Error %d: failed to configure interrupt on %s pin %d\n",
                ret, button2.port->name, button2.pin);
        return 0;
    }

    /* Add callbacks */
    gpio_init_callback(&button_cb, &button_cb_f, BIT(button1.pin) | BIT(button2.pin));
    gpio_add_callback_dt(&button1, &button_cb);
    gpio_add_callback_dt(&button2, &button_cb);

    return 1;
}

static void idle_entry(void *o)
{
    LOG_DBG("STATE IDLE\n");
    k_timer_stop(&hold_timer);
    smf_event_handler.hold_time = 0;
}

static void idle_run(void *o)
{
    if (smf_event_handler.events & EVENT_BTN_LEFT_DOWN)
    {
        smf_set_state(&smf_event_handler.ctx, &sm_event_handler_states[LEFT_PRESSED]);
    }
    else if (smf_event_handler.events & EVENT_BTN_RIGHT_DOWN)
    {
        smf_set_state(&smf_event_handler.ctx, &sm_event_handler_states[RIGHT_PRESSED]);
    }
}

static void left_pressed_entry(void *o)
{
    LOG_DBG("STATE LEFT\n");
}

static void left_pressed_run(void *o)
{
    if (smf_event_handler.events & EVENT_BTN_LEFT_UP)
    {
        LOG_INF("Left press\n");
        k_event_post(sm_events, EVENT_PRESS_LEFT);
        smf_set_state(&smf_event_handler.ctx, &sm_event_handler_states[IDLE]);
    }
    else if (smf_event_handler.events & EVENT_BTN_RIGHT_DOWN)
    {
        smf_set_state(&smf_event_handler.ctx, &sm_event_handler_states[BOTH_PRESSED]);
    }
}

static void right_pressed_entry(void *o)
{
    LOG_DBG("STATE RIGHT\n");
    smf_event_handler.hold_time = 0;
    k_timer_start(&hold_timer, K_SECONDS(1), K_SECONDS(1));
}

static void right_pressed_run(void *o)
{
    // when pressed the btn right event is a release
    if (smf_event_handler.events & EVENT_BTN_RIGHT_UP)
    {
        LOG_INF("Right press\n");
        k_event_post(sm_events, EVENT_PRESS_RIGHT);
        smf_set_state(&smf_event_handler.ctx, &sm_event_handler_states[IDLE]);
    }
    else if (smf_event_handler.events & EVENT_BTN_LEFT_DOWN)
    {
        smf_set_state(&smf_event_handler.ctx, &sm_event_handler_states[BOTH_PRESSED]);
    }
    else if (smf_event_handler.events & EVENT_TIMER_10S)
    {
        LOG_INF("right hold 10s\n");
        k_event_post(sm_events, EVENT_HOLD_RIGHT_10S);
    }
    else if (smf_event_handler.hold_time)
    {
        LOG_INF("right hold\n");
        k_event_post(sm_events, EVENT_HOLD_RIGHT);
    }
}

static void both_pressed_entry(void *o)
{
    LOG_DBG("STATE BOTH\n");
    smf_event_handler.hold_time = 0;
    k_timer_start(&hold_timer, K_SECONDS(1), K_SECONDS(1));
}

static void both_pressed_run(void *o)
{
    if (smf_event_handler.events & EVENT_TIMER_3S)
    {
        LOG_INF("hold both\n");
        k_event_post(sm_events, EVENT_HOLD_BOTH_3S);
        k_timer_stop(&hold_timer);
    }
    // when pressed the btn left event is a release
    else if (smf_event_handler.events & EVENT_BTN_LEFT_UP)
    {
        LOG_INF("press both\n");
        k_event_post(sm_events, EVENT_PRESS_BOTH);
        smf_set_state(&smf_event_handler.ctx, &sm_event_handler_states[IDLE]);
    }
    // when pressed the btn right event is a release
    else if (smf_event_handler.events & EVENT_BTN_RIGHT_UP)
    {
        LOG_INF("press both\n");
        k_event_post(sm_events, EVENT_PRESS_BOTH);
        smf_set_state(&smf_event_handler.ctx, &sm_event_handler_states[IDLE]);
    }
}

static void run_sm(struct k_work *work)
{
    smf_event_handler.events = k_event_wait(&smf_event_handler.input_events, 0x3F, false, K_NO_WAIT);
    LOG_DBG("Events: %d\n", smf_event_handler.events);
    smf_run_state(SMF_CTX(&smf_event_handler));
    k_event_clear(&smf_event_handler.input_events, 0x3F);
}

static void hold_timer_cb(struct k_timer *timer)
{
    smf_event_handler.hold_time += 1;
    LOG_DBG("Timer: %d\n", smf_event_handler.hold_time);
    if (smf_event_handler.hold_time == 10)
    {
        k_event_post(&smf_event_handler.input_events, EVENT_TIMER_10S);
    }
    else if (smf_event_handler.hold_time == 3)
    {
        k_event_post(&smf_event_handler.input_events, EVENT_TIMER_3S);
    }
    k_work_submit(&sm_event_handler_run);
}

int sm_event_handler_init(struct k_event *events)
{
    buttons_init();

    /* Initialise the outgoing state machine event */
    sm_events = events;
    k_event_init(sm_events);

    /* initialise the input events*/
    k_event_init(&smf_event_handler.input_events);

    /* initialise smf_event_handler state machine*/
    smf_set_initial(SMF_CTX(&smf_event_handler), &sm_event_handler_states[IDLE]);

    return 0;
}
```

## src/state_machine.c
```c
#include "inc/state_machine.h"
#include "inc/sm_event_handler.h"

#include <zephyr/kernel.h>
#include <zephyr/smf.h>
#include <zephyr/drivers/gpio.h>
#include <stdbool.h>
#include "rg_led/rg_led.h"

#include <zephyr/logging/log.h>
LOG_MODULE_REGISTER(sm, CONFIG_SM_LOG_LEVEL);

int ret;

const struct device *const led_dev = DEVICE_DT_GET(DT_NODELABEL(ledcontroller));

/* Forward declaration of state table */
struct smf_state mvpi_states[];

// /* User defined object */
struct s_object
{
	/* This must be first */
	struct smf_ctx ctx;

	/* Events */
	struct k_event smf_event;
	int32_t events;

	/* Other state specific data add here */
} s_obj;

/* List of MVPI states */
enum mvpi_state
{
	Standby,
	Operational,
	Configuration,
	Configuration_idle,
	Reset_menu,
	Standby_state,
	Factory_reset
};

uint8_t state_index = Standby;

/* List of rg_led colors including "off" */
enum led_color
{
	LED_COLOR_RED = RG_LED_COLOR_RED,
	LED_COLOR_GREEN = RG_LED_COLOR_GREEN,
	LED_COLOR_YELLOW = RG_LED_COLOR_YELLOW,
	LED_COLOR_OFF = 3,
};

enum led
{
	LED_LEFT = 0,
	LED_RIGHT = 1,
};

struct state_leds
{
	enum led_color led_color_left;
	enum led_color led_color_right;
};

/**
 *  @def leds_off()
 * @brief Function to turn off both LEDs
 */
void leds_off();

/**
 *  @def leds_off_caller()
 * @brief Function to start timer for calling leds_off
 */
void leds_off_caller();

/**
 *  @def show_state()
 * @param stay_on   Flag that will keep the LED state display on if enabled
 * @brief Function to show state using LEDs
 */
void show_state(bool stay_on);

/**
 *  @def timeout_handler()
 * @brief Function to revert to Operational state from Configuration
 */
void timeout_handler();

/**
 *  @def timeout_handler_caller()
 * @brief Function to start timer for calling timeout_handler
 */
void timeout_handler_caller();

/**
 *  @def standby_entry()
 * @brief Function to run once, on entering Standby state
 */
void Standby_entry(void *o);

/**
 *  @def standby_run()
 * @brief Main function to run in Standby state
 */
void Standby_run(void *o);

/**
 *  @def standby_exit()
 * @brief Function to run once, on exiting Standby state
 */
void Standby_exit(void *o);

/**
 *  @def operational_entry()
 * @brief Function to run once, on entering Operational state
 */
void Operational_entry(void *o);

/**
 *  @def operational_run()
 * @brief Main function to run in Operational state
 */
void Operational_run(void *o);

/**
 *  @def operational_exit()
 * @brief Function to run once, on exiting Operational state
 */
void Operational_exit(void *o);

/**
 *  @def configuration_entry()
 * @brief Function to run once, on entering Configuration state
 */
void Configuration_entry(void *o);

/**
 *  @def configuration_exit()
 * @brief Function to run once, on exiting Configuration state
 */
void Configuration_exit(void *o);

/**
 *  @def configuration_idle_entry()
 * @brief Function to run once, on entering Configuration_idle state
 */
void Configuration_idle_entry(void *o);

/**
 *  @def configuration_idle_run()
 * @brief Main function to run in Configuration_idle state
 */
void Configuration_idle_run(void *o);

/**
 *  @def Reset_menu_entry()
 * @brief Function to run once, on entering Reset_menu state
 */
void Reset_menu_entry(void *o);

/**
 *  @def Reset_menu_run()
 * @brief Main function to run in Reset_menu state
 */
void Reset_menu_run(void *o);

void Reset_menu_exit(void *o);

/**
 *  @def Standby_state_entry()
 * @brief Function to run once, on entering Standby_state state
 */
void Standby_state_entry(void *o);

/**
 *  @def Standby_state_run()
 * @brief Main function to run in Standby_state state
 */
void Standby_state_run(void *o);

void Standby_state_exit(void *o);

/**
 *  @def Factory_reset_entry()
 * @brief Function to run once, on entering Factory_reset state
 */
void Factory_reset_entry(void *o);

/**
 *  @def Factory_reset_run()
 * @brief Main function to run in Factory_reset state
 */
void Factory_reset_run(void *o);

void Factory_reset_exit(void *o);

const struct state_leds state_to_state_leds[] = {
	[Standby] = {LED_COLOR_RED, LED_COLOR_RED},
	[Operational] = {LED_COLOR_GREEN, LED_COLOR_GREEN},
	[Configuration] = {LED_COLOR_YELLOW, LED_COLOR_YELLOW},
	[Configuration_idle] = {LED_COLOR_OFF, LED_COLOR_OFF},
	[Reset_menu] = {LED_COLOR_RED, LED_COLOR_OFF},
	[Standby_state] = {LED_COLOR_RED, LED_COLOR_GREEN},
	[Factory_reset] = {LED_COLOR_RED, LED_COLOR_RED}};

// Define function to turn off both leds
void leds_off()
{
	LOG_DBG("leds off\n");
	rg_led_off(led_dev, LED_LEFT);
	rg_led_off(led_dev, LED_RIGHT);
}
K_WORK_DEFINE(leds_off_work, leds_off);

// Define function to submit leds_off to workqueue using the timer
void leds_off_caller()
{
	k_work_submit(&leds_off_work);
}
K_TIMER_DEFINE(led_timer, leds_off_caller, NULL);

void show_state(bool stay_on)
{
	struct state_leds led_colors = state_to_state_leds[state_index];

	if (led_colors.led_color_left == LED_COLOR_OFF)
	{
		rg_led_off(led_dev, LED_LEFT);
	}
	else
	{
		rg_led_on(led_dev, LED_LEFT, led_colors.led_color_left);
	}

	if (led_colors.led_color_right == LED_COLOR_OFF)
	{
		rg_led_off(led_dev, LED_RIGHT);
	}
	else
	{
		rg_led_on(led_dev, LED_RIGHT, led_colors.led_color_right);
	}

	if (!stay_on)
	{
		k_timer_start(&led_timer, K_SECONDS(1), K_NO_WAIT);
	}
}

/* 30S timer for configuration timeout */
void timeout_handler()
{
	if (state_index > Operational)
	{
		smf_set_state(SMF_CTX(&s_obj), &mvpi_states[Operational]);
	}
}
K_WORK_DEFINE(timeout_handler_work, timeout_handler);

void timeout_handler_caller()
{
	k_work_submit(&timeout_handler_work);
}
K_TIMER_DEFINE(timeout, timeout_handler_caller, NULL);

/* 1S timer for exiting Configuration_idle mode */
void enter_configuration_idle()
{
	leds_off();
}
K_WORK_DEFINE(enter_configuration_idle_work, enter_configuration_idle);

void enter_configuration_idle_caller()
{
	k_work_submit(&enter_configuration_idle_work);
}
K_TIMER_DEFINE(configuration_led_timeout, enter_configuration_idle_caller, NULL);

/* State Standby */
void Standby_entry(void *o)
{
	LOG_INF("Standby\n");
	state_index = Standby;
	show_state(false);
}

void Standby_run(void *o)
{
	ret = k_event_wait(&s_obj.smf_event, 0x1F, false, K_NO_WAIT);
	k_event_clear(&s_obj.smf_event, 0x1F);

	switch (ret)
	{
	case EVENT_HOLD_BOTH_3S:
		smf_set_state(SMF_CTX(&s_obj), &mvpi_states[Operational]);
		break;

	case EVENT_HOLD_RIGHT:
		show_state(true);
		break;

	case EVENT_PRESS_RIGHT:
		leds_off();
		break;

	default:
		break;
	}
}

void Standby_exit(void *o)
{
	leds_off();
}

/* State Operational */
void Operational_entry(void *o)
{
	LOG_INF("Operational\n");
	state_index = Operational;
	show_state(false);
}

void Operational_run(void *o)
{
	ret = k_event_wait(&s_obj.smf_event, 0x1F, false, K_NO_WAIT);
	k_event_clear(&s_obj.smf_event, 0x1F);

	switch (ret)
	{
	case EVENT_HOLD_BOTH_3S:
		smf_set_state(SMF_CTX(&s_obj), &mvpi_states[Configuration_idle]);
		break;

	case EVENT_HOLD_RIGHT:
		show_state(true);
		break;

	case EVENT_PRESS_RIGHT:
		leds_off();
		break;

	default:
		break;
	}
}

void Operational_exit(void *o)
{
	leds_off();
}

void Configuration_entry(void *o)
{
	state_index = Configuration;
	show_state(false);
	k_timer_start(&configuration_led_timeout, K_SECONDS(1), K_NO_WAIT);
}

void Configuration_exit(void *o)
{
	leds_off();
}

void Configuration_idle_entry(void *o)
{
	state_index = Configuration_idle;
	LOG_INF("Configuration_idle\n");
}

void Configuration_idle_run(void *o)
{
	ret = k_event_wait(&s_obj.smf_event, 0x1F, false, K_NO_WAIT);
	k_event_clear(&s_obj.smf_event, 0x1F);

	switch (ret)
	{
	case EVENT_HOLD_BOTH_3S:
		smf_set_state(SMF_CTX(&s_obj), &mvpi_states[Operational]);
		break;

	case EVENT_PRESS_LEFT:
		smf_set_state(SMF_CTX(&s_obj), &mvpi_states[Reset_menu]);
		break;
	}
}

/* State Reset_menu */
void Reset_menu_entry(void *o)
{
	state_index = Reset_menu;
	LOG_INF("Reset_menu\n");
	show_state(true);

	k_timer_start(&timeout, K_SECONDS(30), K_NO_WAIT);
}

void Reset_menu_run(void *o)
{
	ret = k_event_wait(&s_obj.smf_event, 0x1F, false, K_NO_WAIT);
	k_event_clear(&s_obj.smf_event, 0x1F);

	switch (ret)
	{
	case EVENT_HOLD_BOTH_3S:
		smf_set_state(SMF_CTX(&s_obj), &mvpi_states[Operational]);
		break;

	case EVENT_PRESS_LEFT:
		smf_set_state(SMF_CTX(&s_obj), &mvpi_states[Configuration_idle]);
		break;

	case EVENT_PRESS_RIGHT:
		smf_set_state(SMF_CTX(&s_obj), &mvpi_states[Standby_state]);
		break;

	default:
		break;
	}
}

void Reset_menu_exit(void *o)
{
	leds_off();
}

/* State Standby_state */
void Standby_state_entry(void *o)
{
	k_timer_start(&timeout, K_SECONDS(30), K_NO_WAIT);

	LOG_INF("Standby_state\n");
	state_index = Standby_state;
	show_state(true);
}

void Standby_state_run(void *o)
{
	ret = k_event_wait(&s_obj.smf_event, 0x1F, false, K_NO_WAIT);
	k_event_clear(&s_obj.smf_event, 0x1F);

	switch (ret)
	{
	case EVENT_HOLD_BOTH_3S:
		smf_set_state(SMF_CTX(&s_obj), &mvpi_states[Operational]);
		break;

	case EVENT_PRESS_RIGHT:
		smf_set_state(SMF_CTX(&s_obj), &mvpi_states[Factory_reset]);
		break;

	case EVENT_PRESS_BOTH:
		smf_set_state(SMF_CTX(&s_obj), &mvpi_states[Standby]);
		break;

	default:
		break;
	}
}

void Standby_state_exit(void *o)
{
	leds_off();
}

/* State Factory_reset */
void Factory_reset_entry(void *o)
{
	k_timer_start(&timeout, K_SECONDS(30), K_NO_WAIT);

	LOG_INF("Factory_reset\n");
	state_index = Factory_reset;
	show_state(true);
}

void Factory_reset_run(void *o)
{
	ret = k_event_wait(&s_obj.smf_event, 0x1F, false, K_NO_WAIT);
	k_event_clear(&s_obj.smf_event, 0x1F);

	switch (ret)
	{
	case EVENT_HOLD_BOTH_3S:
		smf_set_state(SMF_CTX(&s_obj), &mvpi_states[Operational]);
		break;

	case EVENT_PRESS_RIGHT:
		smf_set_state(SMF_CTX(&s_obj), &mvpi_states[Reset_menu]);
		break;

	case EVENT_PRESS_BOTH:
		printk("Factory Resetting...\n");
		break;

	default:
		break;
	}
}

void Factory_reset_exit(void *o)
{
	leds_off();
}

/* Populate state table */
struct smf_state mvpi_states[] = {
	[Standby] = SMF_CREATE_STATE(Standby_entry, Standby_run, Standby_exit, NULL),
	[Operational] = SMF_CREATE_STATE(Operational_entry, Operational_run, Operational_exit, NULL),
	[Configuration] = SMF_CREATE_STATE(Configuration_entry, NULL, Configuration_exit, NULL),
	[Configuration_idle] = SMF_CREATE_STATE(Configuration_idle_entry, Configuration_idle_run, NULL, &mvpi_states[Configuration]),
	[Reset_menu] = SMF_CREATE_STATE(Reset_menu_entry, Reset_menu_run, Reset_menu_exit, &mvpi_states[Configuration]),
	[Standby_state] = SMF_CREATE_STATE(Standby_state_entry, Standby_state_run, Standby_state_exit, &mvpi_states[Configuration]),
	[Factory_reset] = SMF_CREATE_STATE(Factory_reset_entry, Factory_reset_run, Factory_reset_exit, &mvpi_states[Configuration]),
};

void state_machine_init()
{

	sm_event_handler_init(&s_obj.smf_event);

	/* Setup led controller */
	if (!led_dev)
	{
		LOG_ERR("No device found\n");
	}
	else if (!device_is_ready(led_dev))
	{
		LOG_ERR("led device is not ready\n");
	}
	else
	{
		LOG_INF("found led device %s\n", led_dev->name);
	}

	/* Set initial state */
	smf_set_initial(SMF_CTX(&s_obj), &mvpi_states[Standby]);
}

void state_machine_run()
{
	/* Run the state machine */
	while (1)
	{
		k_msleep(100);
		ret = smf_run_state(SMF_CTX(&s_obj));
	}
}
```
