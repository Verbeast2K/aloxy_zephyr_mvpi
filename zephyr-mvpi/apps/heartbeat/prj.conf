## CMakeLists.txt
```
#-------------------------------------------------------------------------------
# Zephyr Example Application
#
# Copyright (c) 2021 Nordic Semiconductor ASA
# SPDX-License-Identifier: Apache-2.0

cmake_minimum_required(VERSION 3.13.1)

set(BOARD mvpi_pulse_STM32L071)
# set(FILE_SUFFIX sc620_mvpi_pulse_STM32L071)

find_package(Zephyr REQUIRED HINTS $ENV{ZEPHYR_BASE})

project(app LANGUAGES C)

target_include_directories(app PRIVATE src/inc)
target_sources(app PRIVATE src/main.c)
# target_sources(app PRIVATE src/serial_interface.c)
```

## Kconfig
```
# Copyright (c) 2021 Nordic Semiconductor ASA
# SPDX-License-Identifier: Apache-2.0
#
# This file is the application Kconfig entry point. All application Kconfig
# options can be defined here or included via other application Kconfig files.
# You can browse these options using the west targets menuconfig (terminal) or
# guiconfig (GUI).

menu "Zephyr"
source "Kconfig.zephyr"
endmenu

module = app
module-str = app
# source "subsys/logging/Kconfig.template.log_config"

menu "modem"
    menu "Logging"
    
        config LOG
            bool "Logging"
            select PRINTK if USERSPACE
            help
                Global switch for the logger, when turned off log calls will not be
                compiled in.

        if LOG

            module = MODEM
            module-str = modem
            osource "subsys/logging/Kconfig.template.log_config"

            module = SERIAL_INTERFACE
            module-str = serial_interface
            osource "subsys/logging/Kconfig.template.log_config"

            # module = SM
            # module-str = sm
            # osource "subsys/logging/Kconfig.template.log_config"

            # module = EVENT_HANDLER
            # module-str = event_handler
            # osource "subsys/logging/Kconfig.template.log_config"

            # module = SC620
            # module-str = sc620
            # osource "subsys/logging/Kconfig.template.log_config"

        endif # LOG

    endmenu
endmenu
```

## prj.conf
```kconfig
# Copyright (c) 2021 Nordic Semiconductor ASA
# SPDX-License-Identifier: Apache-2.0

# This file contains selected Kconfig options for the application.
CONFIG_LOG=y
CONFIG_LOG_DEFAULT_LEVEL=4
CONFIG_KERNEL_LOG_LEVEL_INF=y
CONFIG_CONSOLE=y
CONFIG_UART_CONSOLE=n
CONFIG_RTT_CONSOLE=y
CONFIG_USE_SEGGER_RTT=y

CONFIG_LOG_BACKEND_RTT=y
# CONFIG_SHELL_BACKEND_RTT=y
CONFIG_ASSERT=y
# CONFIG_DEBUG_THREAD_INFO=y
# CONFIG_DEBUG_OPTIMIZATIONS=y

CONFIG_GPIO=y

# CONFIG_I2C=n
# CONFIG_I2C_SHELL=n
# CONFIG_I2C_DUMP_MESSAGES=y
# CONFIG_I2C_LOG_LEVEL_DBG=y

# # # State machine support
CONFIG_SMF=y
CONFIG_SMF_ANCESTOR_SUPPORT=y

CONFIG_EVENTS=y

# CONFIG_SYSTEM_WORKQUEUE_STACK_SIZE=2048
CONFIG_SYSTEM_WORKQUEUE_STACK_SIZE=4096

# PM gives problems with I2C right now
CONFIG_PM=y
CONFIG_PM_DEVICE=y
CONFIG_PM_DEVICE_RUNTIME=y

# # Enable the UART driver
# CONFIG_SERIAL=y
CONFIG_UART_ASYNC_API=y
# CONFIG_UART_STM32=y
# CONFIG_UART_INTERRUPT_DRIVEN=n

# # Enable the UART driver
# CONFIG_SHELL=y
# CONFIG_USART_2_INTERRUPT_DRIVEN=y
# CONFIG_USART_2_ASYNC=n

# CONFIG_SERIAL=y
# CONFIG_LPUART_1_ASYNC=y
# CONFIG_LPUART_1_INTERRUPT_DRIVEN=n


CONFIG_CRC=y

# CONFIG_HEAP_MEM_POOL_SIZE=2048
CONFIG_HEAP_MEM_POOL_SIZE=4096

# CONFIG_SC620=n

# CONFIG_FLASH=y
# CONFIG_SPI=y
# CONFIG_SPI_NOR=y
# CONFIG_FLASH_JESD216_API=y

# CONFIG_DMA=y
```

## debug.conf
```kconfig
CONFIG_LOG=y
CONFIG_LOG_DEFAULT_LEVEL=4
CONFIG_KERNEL_LOG_LEVEL_INF=y
CONFIG_CONSOLE=y
CONFIG_UART_CONSOLE=n
CONFIG_RTT_CONSOLE=y
CONFIG_USE_SEGGER_RTT=y
```

## boards/mvpi_pulse_STM32L071.overlay
```dts
/ {
    chosen {
        aloxy,modem_interface-uart = &lpuart1;
    };
};
```

## src/heartbeat_file.c
```c
#include <zephyr/kernel.h>
#include <zephyr/drivers/uart.h>

#include "inc/heartbeat_file.h"

typedef struct
{
    uint8_t counter;
    uint8_t state;
} heartbeat_file_t;

heartbeat_file_t heartbeat_file =
    {
        .counter = 0,
        .state = 0};

// heartbeat_file_initialize()
// {

// }

// heartbeat_file_send()
// {
//     int ret = uart_tx(heartbeat_file)
// }
```
