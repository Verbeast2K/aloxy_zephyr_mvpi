## CMakeLists.txt
```
#-------------------------------------------------------------------------------
# Zephyr Example Application
#
# Copyright (c) 2021 Nordic Semiconductor ASA
# SPDX-License-Identifier: Apache-2.0

cmake_minimum_required(VERSION 3.13.1)

set(BOARD mvpi_pulse_STM32L071)
# set(FILE_SUFFIX sc620_mvpi_pulse_STM32L071)

find_package(Zephyr REQUIRED HINTS $ENV{ZEPHYR_BASE})

project(app LANGUAGES C)

target_sources(app PRIVATE src/main.c)
```

## Kconfig
```
# Copyright (c) 2021 Nordic Semiconductor ASA
# SPDX-License-Identifier: Apache-2.0
#
# This file is the application Kconfig entry point. All application Kconfig
# options can be defined here or included via other application Kconfig files.
# You can browse these options using the west targets menuconfig (terminal) or
# guiconfig (GUI).

menu "Zephyr"
source "Kconfig.zephyr"
endmenu

module = app
module-str = app
source "subsys/logging/Kconfig.template.log_config"
```

## prj.conf
```kconfig
# Copyright (c) 2021 Nordic Semiconductor ASA
# SPDX-License-Identifier: Apache-2.0
#
# This file contains selected Kconfig options for the application.


CONFIG_UART_CONSOLE=y
CONFIG_RTT_CONSOLE=n
CONFIG_USE_SEGGER_RTT=n

CONFIG_GPIO=y
CONFIG_LOG=y



CONFIG_I2C=y
# CONFIG_I2C_SHELL=y

# CONFIG_I2C_DUMP_MESSAGES=y
# CONFIG_I2C_LOG_LEVEL_DBG=y

CONFIG_SC620=y
```

## debug.conf
```kconfig
# Copyright (c) 2021 Nordic Semiconductor ASA
# SPDX-License-Identifier: Apache-2.0
#
# This is a Kconfig fragment which can be used to enable debug-related options
# in the application. See the README for more details.

# compiler
CONFIG_DEBUG_OPTIMIZATIONS=y

# console
CONFIG_CONSOLE=y

# UART console
CONFIG_SERIAL=y
CONFIG_UART_CONSOLE=y

# logging
CONFIG_LOG=y
CONFIG_APP_LOG_LEVEL_DBG=y

# I2C logging
CONFIG_I2C=y
CONFIG_I2C_DUMP_MESSAGES=y
CONFIG_I2C_LOG_LEVEL_DBG=y
```

## boards/sc620_mvpi_pulse_STM32L071.overlay
```dts
// &gpio_keys {
//     compatible="gpio-keys"
//     enable_sc620: enable_sc620 {
//         gpios = <&gpioh 0 GPIO_ACTIVE_HIGH>;
//     };

// };

// &i2c1 {
// 	status = "okay";
// 	clock-frequency = <I2C_BITRATE_STANDARD>;

// 	sc620: sc620@e0 {
// 		compatible = "st,sc620";
// 		label = "sc620";
// 		reg = < 0xe0 >;
// 	};
// };
```

## src/main.c
```c
#include <zephyr/kernel.h>
#include <zephyr/device.h>
#include "rg_led/rg_led.h"

const struct device *const led_dev = DEVICE_DT_GET(DT_NODELABEL(ledcontroller));

int main(void)
{
    printk("In main\n");
    if (!led_dev)
    {
        printk("No device found\n");
    }
    else if (!device_is_ready(led_dev))
    {
        printk("led device is not ready\n");
    }
    else
    {
        printk("found led device %s\n", led_dev->name);
    }
    while (1)
    {
        rg_led_on(led_dev, 0, RG_LED_COLOR_GREEN);
        printk("turn led on\n");
        k_msleep(2000);
        rg_led_on(led_dev, 1, RG_LED_COLOR_YELLOW);
        rg_led_off(led_dev, 0);
        printk("turn led off\n");
        k_msleep(2000);
        rg_led_off(led_dev, 1);
    }
}
```
